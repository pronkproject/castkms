## drivers/gpu/drm/castkms/Kconfig
```kconfig
# SPDX-License-Identifier: GPL-2.0-only

config DRM_CASTKMS
	tristate "CastKMS virtual display (Rust, experimental)"
	depends on DRM=y
	depends on RUST
	depends on MMU
	select RUST_DRM_GEM_SHMEM_HELPER
	select DRM_KMS_HELPER
	select DRM_DISPLAY_HELPER
	select DRM_DISPLAY_HDMI_CEC_HELPER
	help
	  Development version of the CastKMS virtual display driver. It provides
	  one to eight virtual outputs and atomic modesetting with software vblank.
	  The in-kernel compositor accepts linear RGB, monochrome and YUV buffers,
	  including CPU-mappable imports, at sizes through 8192x8192. Cursor planes
	  and an optional pool of eight shared overlays support positioned, cropped
	  and scaled composition. Output lookup tables and matrices, optional plane
	  color pipelines and YUV color properties are applied in software. The
	  in-kernel compositor does not support tiled storage. Each connector also
	  exposes a native CEC adapter backed by its monitor-control transport.
	  Optional ALSA support exposes one
	  playback card per attached audio sink and separately authorized audio
	  capture. Captures embed the cursor. An authorized userspace renderer can
	  negotiate complete scenes independently of the in-kernel compositor's
	  format and geometry limits.

	  The module is called castkms.

config DRM_CASTKMS_AUDIO
	bool "CastKMS audio playback"
	depends on DRM_CASTKMS && SND=y && SND_PCM=y
	select RUST_SND_PCM
	default y
	help
	  Build Rust ALSA playback support for virtual display audio.

config DRM_CASTKMS_KUNIT_TEST
	bool "CastKMS scene lifetime tests" if !KUNIT_ALL_TESTS
	depends on DRM_CASTKMS && KUNIT=y
	default KUNIT_ALL_TESTS
	help
	  Test composition, display authority, source retirement, renderer
	  transitions, capture delivery and audio with owned test buffers.
	  Registered and unregistered fixtures exercise the real driver callbacks;
	  native completion tests do not qualify external GPU rendering. These
	  tests run when CastKMS is loaded.
```
